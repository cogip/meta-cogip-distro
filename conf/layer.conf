## conf/layer.conf
```bitbake
# meta-cogip-distro layer configuration.

BBPATH .= ":${LAYERDIR}"

BBFILES += "${LAYERDIR}/recipes-*/*/*.bb \
            ${LAYERDIR}/recipes-*/*/*.bbappend"

BBFILE_COLLECTIONS += "cogip-distro"
BBFILE_PATTERN_cogip-distro = "^${LAYERDIR}/"
BBFILE_PRIORITY_cogip-distro = "10"

LAYERSERIES_COMPAT_cogip-distro = "scarthgap"

LAYERDEPENDS_cogip-distro = " \
    core \
    openembedded-layer \
    raspberrypi \
"
```
